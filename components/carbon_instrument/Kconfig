## components/carbon_instrument/Kconfig
```kconfig
menu "Carbon Instrument SDK"

    config CARBON_HANDLER_TASK_STACK_SIZE
        int "Command handler task stack size (bytes)"
        default 6144
        range 2048 32768
        help
            Stack size for the per-command watchdog handler task.
            Set equal to the client task stack (6144) so handlers can
            call the same driver libraries without stack overflow.

    config CARBON_MAX_COMMANDS
        int "Maximum registered commands"
        default 64
        range 8 256
        help
            Maximum number of SCPI commands that can be registered.
            Increase if you have more than 64 custom commands.

    config CARBON_ENABLE_GPIO
        bool "Enable built-in GPIO commands"
        default y
        help
            Compile in GPIO:SET, GPIO:GET?, and GPIO:CONFIG commands.
            Disable to reduce firmware size on devices that don't use GPIO.

    config CARBON_ENABLE_ADC
        bool "Enable built-in ADC commands"
        default y
        help
            Compile in ADC:READ? command.
            Disable to reduce firmware size on devices that don't use ADC.

    config CARBON_ENABLE_UART
        bool "Enable built-in UART commands"
        default y
        help
            Compile in UART:WRITE, UART:READ?, and UART:CONFIG commands.
            Disable to reduce firmware size on devices that don't use UART passthrough.

    config HISLIP_OVERLAP_DEPTH
        int "HiSLIP overlap mode command queue depth"
        default 4
        range 1 16
        help
            Number of commands that can be queued when a client negotiates
            overlap mode. Each slot holds a pointer (not an inline buffer),
            so RAM cost is small. Increase if your client pipelines deeply.

    config CARBON_ERROR_QUEUE_SIZE
        int "SCPI error queue depth"
        default 16
        range 4 64
        help
            Number of errors stored in the SCPI error queue (SYST:ERR?).
            Each entry uses 68 bytes (4-byte code + 64-byte message).

endmenu
```

## main/Kconfig.projbuild
```kconfig
menu "Carbon HiSLIP Instrument Configuration"

    config WIFI_SSID
        string "WiFi SSID"
        default "myssid"
        depends on !CARBON_ENABLE_WIFI_PROVISIONING
        help
            SSID (network name) for the ESP32 to connect to.
            Not used when CARBON_ENABLE_WIFI_PROVISIONING is enabled.

    config WIFI_PASSWORD
        string "WiFi Password"
        default "mypassword"
        depends on !CARBON_ENABLE_WIFI_PROVISIONING
        help
            WiFi password (WPA or WPA2) for the access point.
            Not used when CARBON_ENABLE_WIFI_PROVISIONING is enabled.

    config DEVICE_SERIAL
        string "Device Serial Number"
        default "SN12345"
        help
            Serial number reported in *IDN? response.

    config DEVICE_HOSTNAME
        string "Device Hostname Prefix"
        default "carbon-esp32-inst"
        help
            Hostname prefix for mDNS. MAC address will be appended for uniqueness.

    config HISLIP_SYNC_PORT
        int "HiSLIP TCP Listener Port"
        default 4880
        help
            TCP listener port for HiSLIP data and control connections.

    config CARBON_WIFI_MAX_RETRY
        int "WiFi connection maximum retries"
        default 5
        range 1 20
        help
            Number of times to retry a WiFi connection before giving up.
            When provisioning is enabled, exhausting retries erases stored
            credentials and reboots the device into provisioning mode.

    config CARBON_ENABLE_WIFI_PROVISIONING
        bool "Enable runtime WiFi provisioning (BLE/SoftAP)"
        default n
        help
            When enabled, WiFi credentials are configured at runtime via BLE
            or SoftAP instead of at compile-time via WIFI_SSID/WIFI_PASSWORD.
            On first boot (or when the reset GPIO is held low at boot), the
            device enters provisioning mode and advertises a network named
            "CARBON-XXXXXX". Credentials are stored in NVS; subsequent boots
            connect automatically. If stored credentials fail after
            CARBON_WIFI_MAX_RETRY retries, credentials are erased and the
            device reboots into provisioning mode.

    choice CARBON_PROVISION_TRANSPORT
        prompt "Provisioning transport"
        depends on CARBON_ENABLE_WIFI_PROVISIONING
        default CARBON_PROVISION_SOFTAP
        help
            Transport used to deliver WiFi credentials to the device.

        config CARBON_PROVISION_SOFTAP
            bool "SoftAP"
            help
                Device creates a Wi-Fi access point named "CARBON-XXXXXX".
                Connect to it and use the Espressif Provisioning app or a
                browser to enter credentials.

        config CARBON_PROVISION_BLE
            bool "BLE"
            help
                Device advertises via Bluetooth LE. Requires an ESP32 with
                BLE support. Use the Espressif BLE Provisioning app.

    endchoice

    config CARBON_PROVISION_GPIO_ENABLE
        bool "Enable provisioning reset GPIO"
        default n
        depends on CARBON_ENABLE_WIFI_PROVISIONING
        help
            When enabled, holding the specified GPIO pin low at boot clears
            stored WiFi credentials and forces provisioning mode.

    config CARBON_PROVISION_GPIO
        int "Provisioning reset GPIO pin number"
        default 0
        range 0 39
        depends on CARBON_PROVISION_GPIO_ENABLE
        help
            GPIO pin monitored for provisioning reset. Active low with
            internal pull-up. Hold low at power-on to re-enter provisioning.

endmenu
```

## sdkconfig.defaults
```kconfig
# WiFi Configuration
CONFIG_WIFI_SSID="myssid"
CONFIG_WIFI_PASSWORD="mypassword"

# lwIP TCP/IP Stack
CONFIG_LWIP_MAX_SOCKETS=16
CONFIG_LWIP_SO_REUSE=y
CONFIG_LWIP_SO_RCVBUF=y

# FreeRTOS
CONFIG_FREERTOS_HZ=1000
CONFIG_FREERTOS_UNICORE=n

# Partition Table
CONFIG_PARTITION_TABLE_SINGLE_APP_LARGE=y

# Serial flasher config
CONFIG_ESPTOOLPY_FLASHSIZE_4MB=y
```
